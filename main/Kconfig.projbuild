## main/Kconfig.projbuild
```kconfig
menu "Example Configuration"

    config ESP_WIFI_SSID
        string "WiFi SSID"
        default "Redmi_k20"
        help
            SSID (network name) for the example to connect to.

    config ESP_WIFI_PASSWORD
        string "WiFi Password"
        default "12345777"
        help
            WiFi password (WPA or WPA2) for the example to use.

    config ESP_MAXIMUM_RETRY
        int "Maximum retry"
        default 5
        help
            Set the Maximum retry to avoid station reconnecting to the AP unlimited when the AP is really inexistent.

    config TMP_IP
	string "NTP_IP"
	default "66.151.147.38"
	help
	    server ntp ip address
    config TMP_ZONE
	string "ZONE"
	default "UTC+00:00"
	help
	    time zone for getting time
    config TMP_FORMAT
	int "FORMAT"
	default 1
	help
	    there are 4 format(1/2/3/4)
    config TMP_PORT
	int "PORT"
	default 123
	help
	    enter port no
    config AP_CON
	int "AP connection"
	default 2
	help
	    led1 gpio

    config RTC_NO
	int "RTC not updated"
	default 5
	help
	    led2 gpio
endmenu
```
